## drivers/meigdrv/GobiNet/Kconfig
```kconfig
menu "Meig GobiNet drivers"
	depends on USB_USBNET

config MEIG_GOBINET
	tristate "Meig GobiNet driver"
	default y
	help
	  meig gobinet driver.
          This driver is required if you want to setup network connection by meig modem.


endmenu
```

## drivers/meigdrv/Kconfig
```kconfig
#
# Amlogic driver configuration
#
config MEIG_DRIVER
	bool "Meig Peripheral drivers"
	default y
	help
		this option is provided for control meig
		drivers, if you want to use meig driver
		please open it


if MEIG_DRIVER
menu "Meig Device Drivers"
source "drivers/meigdrv/GobiNet/Kconfig"
endmenu
endif
```

## drivers/misc/rk628/Kconfig
```kconfig
menu "RK628 misc driver"
config RK628_MISC
	bool "rk628 misc driver"
	default y
	help
	  Say y here to enable Rockchip rk628 thunder boot support.
          This option is used to support rgb/hdmi/bt1120 input and dsi/lvds/gvi/hdmi output

config ROCKCHIP_THUNDER_BOOT_RK628
	bool "Rockchip RK628 Thunder Boot support"
	default y
	help
	  Say y here to enable Rockchip rk628 thunder boot support.
	  This option make the kernel boot faster.

endmenu
```

## drivers/net/wireless/rockchip_wlan/rtl8822cs/Kconfig
```kconfig
config RTL8822CS
	tristate "Realtek 8822C SDIO WiFi for skysi"
	---help---
	  Help message of RTL8822CS
```

## drivers/net/wireless/rockchip_wlan/rtl8822es/Kconfig
```kconfig
config RTL8822ES
	tristate "Realtek 8822E SDIO WiFi for skysi"
	---help---
	  Help message of RTL8822ES
```
